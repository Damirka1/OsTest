ENTRY(bmain16)

OUTPUT_FORMAT(elf64-x86-64)

INPUT
(
    bin/bmain.o
    bin/kernel.o
    bin/include_binaries.o
)

OUTPUT
(
    bin/kernel.elf
)


SECTIONS
{
    . = 0x8000;

    .text : ALIGN(0x1000)
    {
        *(.text)
    }

    .idt BLOCK(0x1000) : ALIGN(0x1000)
    {
        _idt = .;
        . = . + 0x1000;
    }

    .rodata : ALIGN(0x1000)
    {
        *(.rodata)
    }

    .data : ALIGN(0x1000)
    {
        *(.data)
    }

    .bss : ALIGN(0x1000)
    {
        *(COMMON)
        *(.bss)
    }
}

